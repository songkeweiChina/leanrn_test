VERSION ""

NS_ :

BS_:

BU_: Veh_Door GW
VAL_TABLE_ Veh_FrontLight 1 "On" 0 "Off" ;
VAL_TABLE_ Veh_RightDoor 1 "Open" 0 "Off" ;
VAL_TABLE_ Veh_LeftDoor 1 "Open" 0 "Off" ;

BO_ 293 PpDoorStateFrontLeft: 8 Veh_Door
 SG_ PpLDoorState : 0|2@1+ (1,0) [0|0] ""  GW

BO_ 292 PpDoorStateFrontRight: 8 Veh_Door
 SG_ PpRDoorState : 0|2@1+ (1,0) [0|0] ""  GW

BO_ 291 PpLightStateFront: 8 GW
 SG_ PpLightState : 0|2@1+ (1,0) [0|1] "" Vector__XXX

BO_TX_BU_ 291 : Veh_Door,GW;

VAL_ 293 PpLDoorState 1 "Open" 0 "Off" ;
VAL_ 292 PpRDoorState 1 "Open" 0 "Off" ;
VAL_ 291 PpLightState 1 "On" 0 "Off" ;
